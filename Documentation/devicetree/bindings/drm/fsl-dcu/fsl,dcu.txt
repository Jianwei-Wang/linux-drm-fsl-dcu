## Documentation/devicetree/bindings/drm/fsl-dcu/fsl,dcu.txt
```
Device Tree bindings for Freescale DCU DRM Driver

Required properties:
- compatible:           Should be one of
	* "fsl,ls1021a-dcu".
	* "fsl,vf610-dcu".
- reg:                  Address and length of the register set for dcu.
- clocks:               From common clock binding: handle to dcu clock.
- clock-names:          From common clock binding: Shall be "dcu".
- display:              The phandle to display node.

Required properties:
- bits-per-pixel:       <16> for RGB565,
			<24> for RGB888,
			<32> for RGB8888.

Required timing node for dispplay sub-node:
- display-timings:      Refer to binding doc display-timing.txt for details.

Examples:
dcu: dcu@2ce0000 {
	compatible = "fsl,ls1021a-dcu";
	reg = <0x0 0x2ce0000 0x0 0x10000>;
	clocks = <&platform_clk 0>;
	clock-names = "dcu";
	big-endian;
	display = <&display>;

	display: display@0 {
		bits-per-pixel = <24>;

		display-timings {
			native-mode = <&timing0>;
			timing0: nl4827hc19 {
				clock-frequency = <10870000>;
				hactive = <480>;
				vactive = <272>;
				hback-porch = <2>;
				hfront-porch = <2>;
				vback-porch = <1>;
				vfront-porch = <1>;
				hsync-len = <41>;
				vsync-len = <2>;
				hsync-active = <1>;
				vsync-active = <1>;
			};
		};
	};
};
```

## Documentation/devicetree/bindings/video/SiI902x.txt
```
Device-Tree bindings for the SiI902x hdmi transmitter.

Required properties:
- compatible: 	Should be "sii902x".
- reg: 		The I2C address of the device.
- interrupts:	Interrupt number to the cpu.

Example:

&i2c1 {
       status = "okay";
       hdmi: sii9022a@39 {
             compatible = "sii902x";
             reg = <0x39>;
             interrupts = <GIC_SPI 167 IRQ_TYPE_EDGE_RISING>;
       };
};
```

## arch/arm/configs/ls1021a_defconfig
```kconfig
CONFIG_SYSVIPC=y
CONFIG_POSIX_MQUEUE=y
CONFIG_NO_HZ_IDLE=y
CONFIG_HIGH_RES_TIMERS=y
CONFIG_LOG_BUF_SHIFT=16
CONFIG_BLK_DEV_INITRD=y
CONFIG_CC_OPTIMIZE_FOR_SIZE=y
CONFIG_SYSCTL_SYSCALL=y
CONFIG_KALLSYMS_ALL=y
CONFIG_EMBEDDED=y
CONFIG_PROFILING=y
CONFIG_OPROFILE=y
CONFIG_KPROBES=y
CONFIG_JUMP_LABEL=y
CONFIG_MODULES=y
CONFIG_MODULE_FORCE_LOAD=y
CONFIG_MODULE_UNLOAD=y
CONFIG_BLK_CMDLINE_PARSER=y
CONFIG_ARCH_MXC=y
CONFIG_SOC_LS1021A=y
CONFIG_ARM_LPAE=y
CONFIG_PCI=y
CONFIG_PCI_MSI=y
CONFIG_SMP=y
CONFIG_VMSPLIT_2G=y
CONFIG_ARM_PSCI=y
CONFIG_PREEMPT_VOLUNTARY=y
CONFIG_THUMB2_KERNEL=y
CONFIG_HIGHMEM=y
CONFIG_CLEANCACHE=y
CONFIG_FRONTSWAP=y
CONFIG_CMDLINE="console=ttyS0,115200"
CONFIG_VFP=y
CONFIG_NEON=y
CONFIG_KERNEL_MODE_NEON=y
CONFIG_BINFMT_MISC=y
CONFIG_NET=y
CONFIG_PACKET=y
CONFIG_UNIX=y
CONFIG_UNIX_DIAG=y
CONFIG_XFRM_USER=y
CONFIG_NET_KEY=y
CONFIG_INET=y
CONFIG_IP_MULTICAST=y
CONFIG_IP_ADVANCED_ROUTER=y
CONFIG_IP_PNP=y
CONFIG_IP_PNP_DHCP=y
CONFIG_IP_MROUTE=y
CONFIG_INET_AH=y
CONFIG_INET_ESP=y
CONFIG_INET_IPCOMP=y
CONFIG_INET_UDP_DIAG=m
CONFIG_NETFILTER=y
CONFIG_DEVTMPFS=y
CONFIG_DEVTMPFS_MOUNT=y
CONFIG_MTD=y
CONFIG_MTD_CMDLINE_PARTS=y
CONFIG_MTD_BLOCK=y
CONFIG_MTD_CFI=y
CONFIG_MTD_CFI_ADV_OPTIONS=y
CONFIG_MTD_CFI_BE_BYTE_SWAP=y
CONFIG_MTD_CFI_GEOMETRY=y
CONFIG_MTD_CFI_INTELEXT=y
CONFIG_MTD_CFI_AMDSTD=y
CONFIG_MTD_CFI_STAA=y
CONFIG_MTD_PHYSMAP_OF=y
CONFIG_MTD_NAND=y
CONFIG_BLK_DEV_LOOP=y
CONFIG_BLK_DEV_RAM=y
CONFIG_BLK_DEV_RAM_SIZE=256000
CONFIG_BLK_DEV_SD=y
CONFIG_CHR_DEV_SG=y
CONFIG_ATA=y
CONFIG_NETDEVICES=y
CONFIG_GIANFAR=y
CONFIG_VITESSE_PHY=y
CONFIG_BROADCOM_PHY=y
CONFIG_REALTEK_PHY=y
CONFIG_NATIONAL_PHY=y
CONFIG_MICREL_PHY=y
CONFIG_MDIO_BUS_MUX_MMIOREG=y
CONFIG_INPUT_EVDEV=y
CONFIG_SERIO_SERPORT=m
CONFIG_SERIAL_8250=y
CONFIG_SERIAL_8250_CONSOLE=y
CONFIG_SERIAL_8250_EXTENDED=y
CONFIG_SERIAL_8250_SHARE_IRQ=y
CONFIG_SERIAL_OF_PLATFORM=y
CONFIG_SERIAL_FSL_LPUART=y
CONFIG_SERIAL_FSL_LPUART_CONSOLE=y
CONFIG_HW_RANDOM=y
CONFIG_I2C=y
CONFIG_I2C_CHARDEV=y
CONFIG_I2C_MUX=y
CONFIG_I2C_MUX_PCA954x=y
CONFIG_I2C_IMX=y
CONFIG_SPI=y
CONFIG_SPI_FSL_DSPI=y
CONFIG_GPIO_SYSFS=y
CONFIG_SENSORS_LM90=y
CONFIG_SENSORS_INA2XX=y
CONFIG_WATCHDOG=y
CONFIG_IMX2_WDT=y
CONFIG_REGULATOR=y
CONFIG_REGULATOR_DEBUG=y
CONFIG_REGULATOR_FIXED_VOLTAGE=y
CONFIG_SOUND=y
# CONFIG_SOUND_OSS_CORE_PRECLAIM is not set
CONFIG_SND=y
CONFIG_SND_MIXER_OSS=y
CONFIG_SND_PCM_OSS=y
# CONFIG_SND_ARM is not set
CONFIG_SND_SOC=y
CONFIG_SND_SOC_FSL_SAI=y
CONFIG_SND_SOC_SGTL5000=y
CONFIG_SND_SIMPLE_CARD=y
CONFIG_MMC=y
CONFIG_MMC_SDHCI=y
CONFIG_MMC_SDHCI_PLTFM=y
CONFIG_MMC_SDHCI_OF_ARASAN=y
CONFIG_NEW_LEDS=y
CONFIG_LEDS_CLASS=y
CONFIG_LEDS_TRIGGERS=y
CONFIG_RTC_CLASS=y
CONFIG_RTC_DRV_DS3232=y
CONFIG_DMADEVICES=y
CONFIG_FSL_EDMA=y
CONFIG_CLK_QORIQ=y
CONFIG_MEMORY=y
CONFIG_EXT2_FS=y
CONFIG_EXT2_FS_XATTR=y
CONFIG_EXT3_FS=y
CONFIG_EXT4_FS=y
CONFIG_FANOTIFY=y
CONFIG_ISO9660_FS=m
CONFIG_JOLIET=y
CONFIG_ZISOFS=y
CONFIG_UDF_FS=m
CONFIG_MSDOS_FS=y
CONFIG_VFAT_FS=y
CONFIG_NTFS_FS=m
CONFIG_TMPFS=y
CONFIG_TMPFS_POSIX_ACL=y
CONFIG_JFFS2_FS=y
CONFIG_NFS_FS=y
CONFIG_NFS_V4=y
CONFIG_ROOT_NFS=y
CONFIG_NLS_DEFAULT="cp437"
CONFIG_NLS_CODEPAGE_437=y
CONFIG_NLS_ASCII=y
CONFIG_NLS_ISO8859_1=y
CONFIG_NLS_ISO8859_2=y
CONFIG_NLS_ISO8859_15=y
CONFIG_NLS_UTF8=y
CONFIG_DEBUG_SECTION_MISMATCH=y
CONFIG_MAGIC_SYSRQ=y
CONFIG_CRYPTO_LZO=y
CONFIG_CRC_CCITT=m
CONFIG_CRC_T10DIF=y
CONFIG_CRC7=m
CONFIG_LIBCRC32C=m
```

## drivers/gpu/drm/ast/Kconfig
```kconfig
config DRM_AST
	tristate "AST server chips"
	depends on DRM && PCI && X86 && EXPERIMENTAL
	select DRM_TTM
	select FB_SYS_COPYAREA
        select FB_SYS_FILLRECT
        select FB_SYS_IMAGEBLIT
        select DRM_KMS_HELPER
	help
	 Say yes for experimental AST driver
```

## drivers/gpu/drm/cirrus/Kconfig
```kconfig
config DRM_CIRRUS
	tristate "Cirrus driver"
	depends on DRM && PCI
	select FB_CFB_FILLRECT
	select FB_CFB_COPYAREA
	select FB_CFB_IMAGEBLIT
	select DRM_KMS_HELPER
```

## drivers/gpu/drm/fsl-dcu/Kconfig
```kconfig
config DRM_FSL_DCU
	tristate "DRM Support for Freescale DCU"
	depends on DRM && OF && ARM
	select DRM_KMS_HELPER
	select DRM_KMS_CMA_HELPER
	select VIDEOMODE_HELPERS
	select BACKLIGHT_CLASS_DEVICE
	select BACKLIGHT_LCD_SUPPORT
	select REGMAP_MMIO
	select DRM_KMS_FB_HELPER
	select FB_SYS_FILLRECT
	select FB_SYS_COPYAREA
	select FB_SYS_IMAGEBLIT
	select FB_SYS_FOPS
	help
	  Choose this option if you have an Freescale DCU chipset.
	  If M is selected the module will be called fsl-dcu-drm.
```

## drivers/gpu/drm/mgag200/Kconfig
```kconfig
config DRM_MGAG200
	tristate "Kernel modesetting driver for MGA G200 server engines"
	depends on DRM && PCI
	select FB_SYS_FILLRECT
	select FB_SYS_COPYAREA
	select FB_SYS_IMAGEBLIT
	select DRM_KMS_HELPER
```

## drivers/gpu/drm/virgl/Kconfig
```kconfig
config DRM_VIRGL
	tristate "QEMU Virtual 3D GPU"
	depends on DRM && PCI
	select FB_SYS_FILLRECT
	select FB_SYS_COPYAREA
	select FB_SYS_IMAGEBLIT
        select DRM_KMS_HELPER
        select DRM_TTM
	help
	   QEMU based 3D GPU.
```

## drivers/gpu/drm/virtio/Kconfig
```kconfig
config DRM_VIRTIO_GPU
	tristate "QEMU Virtio GPU"
	depends on DRM && VIRTIO
	select FB_SYS_FILLRECT
	select FB_SYS_COPYAREA
	select FB_SYS_IMAGEBLIT
        select DRM_KMS_HELPER
        select DRM_TTM
	help
	   QEMU based virtio GPU.
```
